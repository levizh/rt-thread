## bsp/hc32/ev_hc32f4a0_lqfp176/board/Kconfig
```kconfig
menu "Hardware Drivers Config"

config SOC_HC32F4A0SI
    bool
    select SOC_SERIES_HC32F4
    select RT_USING_COMPONENTS_INIT
    select RT_USING_USER_MAIN
    default y

menu "Onboard Peripheral Drivers"
    menuconfig BSP_USING_ETH
        bool "Enable Ethernet"
        default n
        select RT_USING_LWIP
        select RT_LWIP_USING_HW_CHECKSUM

        if BSP_USING_ETH
            choice
                prompt "Select ETH PHY type"
                default ETH_PHY_USING_RTL8201F

                config ETH_PHY_USING_RTL8201F
                    bool "ETH PHY USING RTL8201F"
                    select BSP_USING_I2C
                    select BSP_USING_I2C1
                    select BSP_USING_TCA9539
                config ETH_PHY_USING_JL11X1
                    bool "ETH PHY USING JL11X1"
            endchoice

            choice
                prompt "Select ETH Communication Interface"
                default ETH_INTERFACE_USING_MII

                config ETH_INTERFACE_USING_MII
                    bool "ETH Communication USING MII"
                config ETH_INTERFACE_USING_RMII
                    bool "ETH Communication USING RMII"
            endchoice

            menuconfig ETH_PHY_USING_INTERRUPT_MODE
                bool "Enable ETH PHY interrupt mode"
                default n
                if ETH_PHY_USING_INTERRUPT_MODE
                    config ETH_PHY_INTERRUPT_PIN
                        int "ETH PHY Interrupt pin number"
                        range 1 176
                        default 16
                endif
        endif

    config BSP_USING_TCA9539
        bool "Enable TCA9539"
        select BSP_USING_I2C
        select BSP_USING_I2C1
        default n

    config BSP_USING_SPI_FLASH
        bool "Enable SPI FLASH (w25q64 spi1)"
        select BSP_USING_SPI
        select RT_USING_SFUD
        default n

    config BSP_USING_QSPI_FLASH
        bool "Enable QSPI FLASH (w25q64)"
        select BSP_USING_QSPI
        select RT_USING_SFUD
        select RT_SFUD_USING_QSPI
        default n

    config BSP_USING_MT29F2G08AB
        bool "Enable NAND FLASH (MT29F2G08AB)"
        select BSP_USING_EXMC
        select BSP_USING_NAND
        select RT_USING_MTD_NAND
        default n

endmenu

menu "On-chip Peripheral Drivers"
    config BSP_USING_GPIO
        bool "Enable GPIO"
        select RT_USING_PIN
        default y

    menuconfig BSP_USING_UART
        bool "Enable UART"
        default y
        select RT_USING_SERIAL
        if BSP_USING_UART
            menuconfig BSP_USING_UART1
                bool "Enable UART1"
                default y
                if BSP_USING_UART1
                    config BSP_UART1_RX_USING_DMA
                        bool "Enable UART1 RX DMA"
                        depends on BSP_USING_UART1 && RT_SERIAL_USING_DMA
                        default n

                    config BSP_UART1_TX_USING_DMA
                        bool "Enable UART1 TX DMA"
                        depends on BSP_USING_UART1 && RT_SERIAL_USING_DMA
                        default n

                    config BSP_UART1_RX_BUFSIZE
                        int "Set UART1 RX buffer size"
                        range 64 65535
                        depends on RT_USING_SERIAL_V2
                        default 256

                    config BSP_UART1_TX_BUFSIZE
                        int "Set UART1 TX buffer size"
                        range 0 65535
                        depends on RT_USING_SERIAL_V2
                        default 0
                endif

            menuconfig BSP_USING_UART2
                bool "Enable UART2"
                default n
                if BSP_USING_UART2
                    config BSP_UART2_RX_USING_DMA
                        bool "Enable UART2 RX DMA"
                        depends on BSP_USING_UART2 && RT_SERIAL_USING_DMA
                        default n

                    config BSP_UART2_TX_USING_DMA
                        bool "Enable UART2 TX DMA"
                        depends on BSP_USING_UART2 && RT_SERIAL_USING_DMA
                        default n

                    config BSP_UART2_RX_BUFSIZE
                        int "Set UART2 RX buffer size"
                        range 64 65535
                        depends on RT_USING_SERIAL_V2
                        default 256

                    config BSP_UART2_TX_BUFSIZE
                        int "Set UART2 TX buffer size"
                        range 0 65535
                        depends on RT_USING_SERIAL_V2
                        default 256
                endif

            config BSP_USING_UART3
                bool "Enable UART3"
                default n

            config BSP_USING_UART4
                bool "Enable UART4"
                default n

            config BSP_USING_UART5
                bool "Enable UART5"
                default n

            menuconfig BSP_USING_UART6
                bool "Enable UART6"
                default y
                if BSP_USING_UART6
                    config BSP_UART6_RX_USING_DMA
                        bool "Enable UART6 RX DMA"
                        depends on BSP_USING_UART6 && RT_SERIAL_USING_DMA
                        default n

                    config BSP_UART6_TX_USING_DMA
                        bool "Enable UART6 TX DMA"
                        depends on BSP_USING_UART6 && RT_SERIAL_USING_DMA
                        default n

                    config BSP_UART6_RX_BUFSIZE
                        int "Set UART6 RX buffer size"
                        range 64 65535
                        depends on RT_USING_SERIAL_V2
                        default 256

                    config BSP_UART6_TX_BUFSIZE
                        int "Set UART6 TX buffer size"
                        range 0 65535
                        depends on RT_USING_SERIAL_V2
                        default 0
                endif

            config BSP_USING_UART7
                bool "Enable UART7"
                default n

            config BSP_UART7_RX_USING_DMA
                bool "Enable UART7 RX DMA"
                depends on BSP_USING_UART7
                select RT_SERIAL_USING_DMA
                default n

            config BSP_UART7_TX_USING_DMA
                bool "Enable UART7 TX DMA"
                depends on BSP_USING_UART7
                select RT_SERIAL_USING_DMA
                default n

            config BSP_USING_UART8
                bool "Enable UART8"
                default n

            config BSP_USING_UART9
                bool "Enable UART9"
                default n

            config BSP_USING_UART10
                bool "Enable UART10"
                default n
        endif

    menuconfig BSP_USING_I2C
        bool "Enable I2C BUS"
        default n
        select RT_USING_I2C
        if BSP_USING_I2C
            config BSP_USING_I2C1_SW
                bool "Enable I2C1 BUS (software simulation)"
                default y
                select RT_USING_I2C_BITOPS
                select RT_USING_PIN
            if BSP_USING_I2C1_SW
                config BSP_I2C1_SCL_PIN
                    int "i2c1 scl pin number"
                    range 1 176
                    default 51
                config BSP_I2C1_SDA_PIN
                    int "I2C1 sda pin number"
                    range 1 176
                    default 90
            endif
        endif

        if BSP_USING_I2C
            config BSP_USING_I2C1
                bool "Enable I2C1 BUS"
                default y
                if BSP_USING_I2C1
                    config BSP_USING_I2C_HW
                    bool
                    default y
                endif
        endif
        if BSP_USING_I2C
            config BSP_USING_I2C2
                bool "Enable I2C2 BUS"
                default n
        endif
        if BSP_USING_I2C
            config BSP_USING_I2C3
                bool "Enable I2C3 BUS"
                default n
        endif
        if BSP_USING_I2C
            config BSP_USING_I2C4
                bool "Enable I2C4 BUS"
                default n
        endif
        if BSP_USING_I2C
            config BSP_USING_I2C5
                bool "Enable I2C5 BUS"
                default n
        endif
        if BSP_USING_I2C
            config BSP_USING_I2C6
                bool "Enable I2C6 BUS"
                default n
        endif

    config BSP_USING_ON_CHIP_FLASH
        bool "Enable on-chip FLASH"
        default n

    menuconfig BSP_USING_SPI
        bool "Enable SPI BUS"
        default n
        select RT_USING_SPI
        if BSP_USING_SPI
            config BSP_USING_SPI1
                bool "Enable SPI1 BUS"
                default n

            config BSP_SPI1_TX_USING_DMA
                bool "Enable SPI1 TX DMA"
                depends on BSP_USING_SPI1
                default n

            config BSP_SPI1_RX_USING_DMA
                bool "Enable SPI1 RX DMA"
                depends on BSP_USING_SPI1
                select BSP_SPI1_TX_USING_DMA
                default n

            config BSP_USING_SPI2
                bool "Enable SPI2 BUS"
                default n

            config BSP_SPI2_TX_USING_DMA
                bool "Enable SPI2 TX DMA"
                depends on BSP_USING_SPI2
                default n

            config BSP_SPI2_RX_USING_DMA
                bool "Enable SPI2 RX DMA"
                depends on BSP_USING_SPI2
                select BSP_SPI2_TX_USING_DMA
                default n

            config BSP_USING_SPI3
                bool "Enable SPI3 BUS"
                default n

            config BSP_SPI3_TX_USING_DMA
                bool "Enable SPI3 TX DMA"
                depends on BSP_USING_SPI3
                default n

            config BSP_SPI3_RX_USING_DMA
                bool "Enable SPI3 RX DMA"
                depends on BSP_USING_SPI3
                select BSP_SPI3_TX_USING_DMA
                default n

            config BSP_USING_SPI4
                bool "Enable SPI4 BUS"
                default n

            config BSP_SPI4_TX_USING_DMA
                bool "Enable SPI4 TX DMA"
                depends on BSP_USING_SPI4
                default n

            config BSP_SPI4_RX_USING_DMA
                bool "Enable SPI4 RX DMA"
                depends on BSP_USING_SPI4
                select BSP_SPI4_TX_USING_DMA
                default n
        endif

    menuconfig BSP_USING_ADC
        bool "Enable ADC"
        default n
        select RT_USING_ADC
        if BSP_USING_ADC
            config BSP_USING_ADC1
                bool "using adc1"
                default n
            config BSP_USING_ADC2
                bool "using adc2"
                default n
            config BSP_USING_ADC3
                bool "using adc3"
                default n
        endif

    menuconfig BSP_USING_DAC
        bool "Enable DAC"
        default n
        select RT_USING_DAC
        if BSP_USING_DAC
            config BSP_USING_DAC1
                bool "using dac1"
                default n
            config BSP_USING_DAC2
                bool "using dac2"
                default n
        endif

    menuconfig BSP_USING_CAN
        bool "Enable CAN"
        default n
        select RT_USING_CAN
        select RT_CAN_USING_HDR
        select BSP_USING_TCA9539
        if BSP_USING_CAN
            config BSP_USING_CAN1
                bool "using can1"
                default n
            config BSP_USING_CAN2
                bool "using can2"
                default n
        endif

    config BSP_USING_WDT
        bool "Enable Watchdog Timer"
        select RT_USING_WDT
        default n
        
    menuconfig BSP_USING_RTC
        bool "Enable RTC"
        select RT_USING_RTC
        default n
        if BSP_USING_RTC
            choice
                prompt "Select clock source"
                default BSP_RTC_USING_XTAL32

                config BSP_RTC_USING_XTAL32
                    bool "RTC USING XTAL32"

                config BSP_RTC_USING_LRC
                    bool "RTC USING LRC"
            endchoice
        endif

    menuconfig BSP_USING_SDIO
        bool "Enable SDIO"
        default n
        select RT_USING_SDIO
        if BSP_USING_SDIO
            config BSP_USING_SDIO1
                bool "Enable SDIO1"
                default n
            config BSP_USING_SDIO2
                bool "Enable SDIO2"
                default n
        endif

    menuconfig BSP_USING_EXMC
        bool "Enable EXMC"
        default n
        select BSP_USING_EXMC
        if BSP_USING_EXMC
            choice
                prompt "Using SDRAM or Nand"
                default BSP_USING_SDRAM

                config BSP_USING_SDRAM
                    bool "Using SDRAM"

                config BSP_USING_NAND
                    bool "Using Nand"
                    select RT_USING_MTD_NAND
            endchoice
        endif

    menuconfig BSP_USING_PM
        bool "Enable PM"
        default n
        select RT_USING_PM

    menuconfig BSP_USING_HWCRYPTO
        bool "Using Hardware Crypto drivers"
        default n
        select RT_USING_HWCRYPTO
        if BSP_USING_HWCRYPTO
            config BSP_USING_UQID
            bool "Enable UQID (unique id)"
            default n

            config BSP_USING_RNG
            bool "Using Hardware RNG"
            select RT_HWCRYPTO_USING_RNG
            default n

            config BSP_USING_CRC
            bool "Using Hardware CRC"
            select RT_HWCRYPTO_USING_CRC
            default n
            if BSP_USING_CRC
                config BSP_USING_CRC16_X25
                    bool "Using Hardware CRC16 0x1021 polynomial"
                    select RT_HWCRYPTO_USING_CRC_1021
                    default n

                config BSP_USING_CRC32
                    bool "Using Hardware CRC32 0x04C11DB7 polynomial"
                    select RT_HWCRYPTO_USING_CRC_04C11DB7
                    default y
            endif

            config BSP_USING_AES
            bool "Using Hardware AES"
            select RT_HWCRYPTO_USING_AES
            default n
            if BSP_USING_AES
                config BSP_USING_AES_ECB
                    bool "Using Hardware AES ECB mode"
                    select RT_HWCRYPTO_USING_AES_ECB
                    default y
            endif

            config BSP_USING_HASH
            bool "Using Hardware Hash"
            select RT_HWCRYPTO_USING_SHA2
            default n
            if BSP_USING_HASH
                config BSP_USING_SHA2_256
                    bool "Using Hardware SHA2_256 mode"
                    select RT_HWCRYPTO_USING_SHA2_256
                    default y
                    if BSP_USING_SHA2_256
                        config BSP_HASH_USING_DMA
                            bool "Enable Hash DMA"
                            default y
                    endif
            endif

        endif

    menuconfig BSP_USING_PWM
        bool "Enable output PWM"
        default n
        select RT_USING_PWM
        if BSP_USING_PWM
            menuconfig BSP_USING_PWM_TIMA
                bool "Enable timerA output PWM"
                default n
                if BSP_USING_PWM_TIMA
                    menuconfig BSP_USING_PWM_TIMA_4
                        bool "Enable timerA-4 output PWM"
                        default n
                        if BSP_USING_PWM_TIMA_4
                            config BSP_USING_PWM_TIMA_4_CH1
                                bool "Enable timerA-4 channel1"
                                default n
                            config BSP_USING_PWM_TIMA_4_CH2
                                bool "Enable timerA-4 channel2"
                                default n
                        endif
                    menuconfig BSP_USING_PWM_TIMA_5
                        bool "Enable timerA-5 output PWM"
                        default n
                        if BSP_USING_PWM_TIMA_5
                            config BSP_USING_PWM_TIMA_5_CH1
                                bool "Enable timerA-5 channel1"
                                default n
                            config BSP_USING_PWM_TIMA_5_CH2
                                bool "Enable timerA-5 channel2"
                                default n
                        endif
                endif
            menuconfig BSP_USING_PWM_TIM4
                bool "Enable timer4 output PWM"
                default n
                if BSP_USING_PWM_TIM4
                    menuconfig BSP_USING_PWM_TIM4_1
                        bool "Enable timer4-1 output PWM"
                        default n
                        if BSP_USING_PWM_TIM4_1
                            config BSP_USING_PWM_TIM4_1_OUH
                                bool "Enable TIM4_1_OUH channel0"
                                default n
                            config BSP_USING_PWM_TIM4_1_OUL
                                bool "Enable TIM4_1_OUL channel1"
                                default n
                            config BSP_USING_PWM_TIM4_1_OVH
                                bool "Enable TIM4_1_OVH channel2"
                                default n
                            config BSP_USING_PWM_TIM4_1_OVL
                                bool "Enable TIM4_1_OVL channel3"
                                default n
                            config BSP_USING_PWM_TIM4_1_OWH
                                bool "Enable TIM4_1_OWH channel4"
                                default n
                            config BSP_USING_PWM_TIM4_1_OWL
                                bool "Enable TIM4_1_OWL channel5"
                                default n
                        endif
                endif
            menuconfig BSP_USING_PWM_TIM6
                bool "Enable timer6 output PWM"
                default n
                if BSP_USING_PWM_TIM6
                    menuconfig BSP_USING_PWM_TIM6_1
                        bool "Enable timer6-1 output PWM"
                        default n
                        if BSP_USING_PWM_TIM6_1
                            config BSP_USING_PWM_TIM6_1_A
                                bool "Enable TIM6_1_A channel0"
                                default n
                            config BSP_USING_PWM_TIM6_1_B
                                bool "Enable TIM6_1_B channel1"
                                default n
                        endif
                endif
        endif

    menuconfig BSP_USING_USB
        bool "Enable USB"
        default n
        select RT_USING_USB_DEVICE if BSP_USING_USBD
        select RT_USING_USB_HOST if BSP_USING_USBH
        if BSP_USING_USB
            choice
                prompt "Select USB FS/HS Core"
                default BSP_USING_USBFS

                config BSP_USING_USBFS
                    bool "Use USBFS Core"

                config BSP_USING_USBHS
                    bool "Use USBHS Core"
            endchoice

            choice
                depends on BSP_USING_USBHS
                prompt "Select USB PHY"
                default BSP_USING_USBHS_PHY_EMBED

                config BSP_USING_USBHS_PHY_EMBED
                    bool "Use USBHS Embedded PHY"

                config BSP_USING_USBHS_PHY_EXTERN
                    bool "Use USBHS External PHY"
                    select BSP_USING_I2C1
                    select BSP_USING_TCA9539
            endchoice

            choice
                prompt "Select USB Mode"
                default BSP_USING_USBD

                config BSP_USING_USBD
                    bool "USB Device Mode"

                config BSP_USING_USBH
                    bool "USB Host Mode"
            endchoice

            if BSP_USING_USBD
                config BSP_USING_USBD_VBUS_SENSING
                    bool "Enable VBUS Sensing"
                    default y
            endif

            if BSP_USING_USBH
                menuconfig RT_USBH_MSTORAGE
                    bool "Enable Udisk Drivers"
                    default n
                    if RT_USBH_MSTORAGE
                        config UDISK_MOUNTPOINT
                        string "Udisk mount dir"
                        default "/"
                    endif
            endif
        endif

    menuconfig BSP_USING_QSPI
        bool "Enable QSPI BUS"
        select RT_USING_QSPI
        select RT_USING_SPI
        default n
        if BSP_USING_QSPI
            config BSP_QSPI_USING_DMA
                bool "Enable QSPI DMA support"
                default n
            config BSP_QSPI_USING_SOFT_CS
                bool "Enable QSPI Soft CS Pin"
                default n
        endif

    menuconfig BSP_USING_PULSE_ENCODER
        bool "Enable Pulse Encoder"
        default n
        select RT_USING_PULSE_ENCODER
        if BSP_USING_PULSE_ENCODER
            menuconfig BSP_USING_TIMERA_PULSE_ENCODER
                bool "Use TIMERA As The Pulse Encoder"
                default n
                if BSP_USING_TIMERA_PULSE_ENCODER
                    config BSP_USING_PULSE_ENCODER_TIMA_1
                        bool "Use TIMERA_1 As The Pulse Encoder"
                        default n
                endif
            menuconfig BSP_USING_TIMER6_PULSE_ENCODER
                bool "Use TIMER6 As The Pulse Encoder"
                default n
                if BSP_USING_TIMER6_PULSE_ENCODER
                    config BSP_USING_PULSE_ENCODER_TIM6_1
                        bool "Use TIMER6_1 As The Pulse Encoder"
                        default n
                endif
        endif

    menuconfig BSP_USING_HWTIMER
        bool "Enable Hw Timer"
        default n
        select RT_USING_HWTIMER
        if BSP_USING_HWTIMER
            config BSP_USING_TIM0_1A
                bool "Use Timer0_1 CHA As The Hw Timer"
                default n
            config BSP_USING_TIM0_1B
                bool "Use Timer0_1 CHB As The Hw Timer"
                default n
            config BSP_USING_TIM0_2A
                bool "Use Timer0_2 CHA As The Hw Timer"
                default n
            config BSP_USING_TIM0_2B
                bool "Use Timer0_2 CHB As The Hw Timer"
                default n
        endif

endmenu

menu "Board extended module Drivers"

endmenu

endmenu
```
