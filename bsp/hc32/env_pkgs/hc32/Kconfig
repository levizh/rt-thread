## bsp/hc32/env_pkgs/hc32/Kconfig
```kconfig
menu "HC32_DDL: DDL library file for HC32"

if SOC_HC32F4A0SI
    source "$PKGS_DIR/packages/peripherals/hal-sdk/hc32/hc32f4a0_ddl/Kconfig"
endif

if SOC_HC32F460PE
    source "$PKGS_DIR/packages/peripherals/hal-sdk/hc32/hc32f460_ddl/Kconfig"
endif

if SOC_HC32F448MC
    source "$PKGS_DIR/packages/peripherals/hal-sdk/hc32/hc32f448_ddl/Kconfig"
endif

if SOC_HC32F472MC
    source "$PKGS_DIR/packages/peripherals/hal-sdk/hc32/hc32f472_ddl/Kconfig"
endif

endmenu
```

## bsp/hc32/env_pkgs/hc32/hc32f448_ddl/Kconfig
```kconfig
# Kconfig file for package hc32f448_ddl
menuconfig PKG_USING_HC32F448_DDL
    bool "Add the HC32F448 library files."
    default n

if PKG_USING_HC32F448_DDL

    config PKG_HC32F448_DDL_PATH
        string
        default "/packages/peripherals/hal-sdk/hc32/hc32f448_ddl"

    choice
        prompt "Version"
        help
            Select the package version

        config PKG_USING_HC32F448_DDL_LATEST_VERSION
            bool "latest"
    endchoice

    config PKG_HC32F448_DDL_VER
       string
       default "latest"    if PKG_USING_HC32F448_DDL_LATEST_VERSION

endif
```

## bsp/hc32/env_pkgs/hc32/hc32f460_ddl/Kconfig
```kconfig
# Kconfig file for package hc32f460_ddl
menuconfig PKG_USING_HC32F460_DDL
    bool "Add the HC32F460 library files."
    default n

if PKG_USING_HC32F460_DDL

    config PKG_HC32F460_DDL_PATH
        string
        default "/packages/peripherals/hal-sdk/hc32/hc32f460_ddl"

    choice
        prompt "Version"
        help
            Select the package version

        config PKG_USING_HC32F460_DDL_LATEST_VERSION
            bool "latest"
    endchoice

    config PKG_HC32F460_DDL_VER
       string
       default "latest"    if PKG_USING_HC32F460_DDL_LATEST_VERSION

endif
```

## bsp/hc32/env_pkgs/hc32/hc32f472_ddl/Kconfig
```kconfig
# Kconfig file for package hc32f472_ddl
menuconfig PKG_USING_HC32F472_DDL
    bool "Add the HC32F472 library files."
    default n

if PKG_USING_HC32F472_DDL

    config PKG_HC32F472_DDL_PATH
        string
        default "/packages/peripherals/hal-sdk/hc32/hc32f472_ddl"

    choice
        prompt "Version"
        help
            Select the package version

        config PKG_USING_HC32F472_DDL_LATEST_VERSION
            bool "latest"
    endchoice

    config PKG_HC32F472_DDL_VER
       string
       default "latest"    if PKG_USING_HC32F472_DDL_LATEST_VERSION

endif
```

## bsp/hc32/env_pkgs/hc32/hc32f4a0_ddl/Kconfig
```kconfig
# Kconfig file for package hc32f4a0_ddl
menuconfig PKG_USING_HC32F4A0_DDL
    bool "Add the HC32F4A0 library files."
    default n

if PKG_USING_HC32F4A0_DDL

    config PKG_HC32F4A0_DDL_PATH
        string
        default "/packages/peripherals/hal-sdk/hc32/hc32f4a0_ddl"

    choice
        prompt "Version"
        help
            Select the package version

        config PKG_USING_HC32F4A0_DDL_LATEST_VERSION
            bool "latest"
    endchoice

    config PKG_HC32F4A0_DDL_VER
       string
       default "latest"    if PKG_USING_HC32F4A0_DDL_LATEST_VERSION

endif
```
